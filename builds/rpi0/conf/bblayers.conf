## builds/rpi0/conf/bblayers.conf
```bitbake
# POKY_BBLAYERS_CONF_VERSION is increased each time build/conf/bblayers.conf
# changes incompatibly
POKY_BBLAYERS_CONF_VERSION = "2"

BBPATH = "${TOPDIR}"
BBFILES ?= ""

BBLAYERS ?= " \
  /home/rowan/sandbox/yocto-pi-zero/poky/meta \
  /home/rowan/sandbox/yocto-pi-zero/poky/meta-poky \
  /home/rowan/sandbox/yocto-pi-zero/poky/meta-yocto-bsp \
  /home/rowan/sandbox/yocto-pi-zero/meta-openembedded/meta-oe \
  /home/rowan/sandbox/yocto-pi-zero/meta-openembedded/meta-python \
  /home/rowan/sandbox/yocto-pi-zero/meta-openembedded/meta-networking \
  /home/rowan/sandbox/yocto-pi-zero/meta-openembedded/meta-multimedia \
  /home/rowan/sandbox/yocto-pi-zero/meta-openembedded/meta-filesystems \
  /home/rowan/sandbox/yocto-pi-zero/meta-raspberrypi \
  "
```
